## config/west.yml
```yaml
manifest:
  remotes:
    - name: thxph
      url-base: https://github.com/thxph
  projects:
    - name: zmk
      remote: thxph
      revision: thxph
      import: app/west.yml
  self:
    path: config
```
